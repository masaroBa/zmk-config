## config/west.yml
```yaml
manifest:
  remotes:
    - name: zmkfirmware
      url-base: https://github.com/zmkfirmware
  projects:
    - name: zmk
      remote: zmkfirmware
      revision: main
      import: app/west.yml
    - name: roba
      url: https://github.com/masaroBa/zmk-nodefree-config
      revision: main
  self:
    path: config
```
